
/dts-v1/;

/include/ "mt6580.dtsi"
/include/ "cust_eint.dtsi"

/ {
	memory@80000000 {
		device_type = "memory";
		reg = <0 0x80000000 0 0x1E800000>;
	};

	bus {
		compatible = "simple-bus";
		#address-cells = <1>;
		#size-cells = <1>;
		ranges = <0 0 0 0xffffffff>;
	};

    /* chosen */
    chosen {
        bootargs = "console=tty0 console=ttyMT0,921600n1 root=/dev/ram initrd=0x84000000,0x400000 loglevel=8";
		/* fpga may has no lk, we need to specify display info here */
		/* fb buffer is reserved using this dts by memory node above */
		atag,videolfb-fb_base = <0x9E800000>;
		atag,videolfb-islcmfound = <1>;
		atag,videolfb-fps= <6000>;
		atag,videolfb-vramSize= <0x01800000>;
		atag,videolfb-lcmname= "nt35590_AUO";
    };
};
